## prj.conf
```kconfig
CONFIG_SYSTEM_WORKQUEUE_STACK_SIZE=2048

CONFIG_BT_SETTINGS=n
CONFIG_FLASH=y
CONFIG_FLASH_MAP=y
CONFIG_NVS=y
CONFIG_SETTINGS=y
CONFIG_HWINFO=y

CONFIG_BT_OBSERVER=y
CONFIG_BT_CTLR_DUP_FILTER_LEN=0
CONFIG_BT_CTLR_LE_ENC=n
CONFIG_BT_DATA_LEN_UPDATE=n
CONFIG_BT_PHY_UPDATE=n
CONFIG_BT_CTLR_CHAN_SEL_2=n
CONFIG_BT_CTLR_MIN_USED_CHAN=n
CONFIG_BT_CTLR_PRIVACY=n

CONFIG_BT_PERIPHERAL=y

CONFIG_BT=y
CONFIG_BT_TINYCRYPT_ECC=y
CONFIG_BT_L2CAP_TX_BUF_COUNT=5

CONFIG_BT_MESH=y
CONFIG_BT_MESH_MODEL_EXTENSIONS=y
CONFIG_BT_MESH_FRIEND=y
CONFIG_BT_MESH_PB_GATT=y
CONFIG_BT_MESH_PB_ADV=y
CONFIG_BT_MESH_GATT_PROXY=y

#CONFIG_BT_MESH_LOW_POWER=y
#CONFIG_BT_MESH_LPN_SCAN_LATENCY=30
#CONFIG_BT_MESH_LPN_RECV_DELAY=40
#CONFIG_BT_MESH_LPN_POLL_TIMEOUT=300

CONFIG_BT_MESH_SUBNET_COUNT=2
CONFIG_BT_MESH_APP_KEY_COUNT=2
CONFIG_BT_MESH_MODEL_GROUP_COUNT=2
CONFIG_BT_MESH_LABEL_COUNT=3

CONFIG_BT_DEBUG_LOG=y

CONFIG_BT_MESH_DEBUG=y
CONFIG_BT_MESH_DEBUG_MODEL=y

#enable gpio tracing
CONFIG_GPIO=y

#enable relaying from mesh
CONFIG_BT_MESH_RELAY=y

#set msg segmentation to 5
CONFIG_BT_MESH_TX_SEG_MSG_COUNT=5

#time to live
CONFIG_BT_MESH_DEFAULT_TTL=2

#pwr level
CONFIG_BT_CTLR_TX_PWR_0=y
#CONFIG_BT_CTLR_TX_PWR_MINUS_4=y
#CONFIG_BT_CTLR_TX_PWR_PLUS_4=y

#relays standard = 2
CONFIG_BT_MESH_RELAY_RETRANSMIT_COUNT=2
```

## boards/nrf52840dk_nrf52840.overlay
```dts
/ {
    aliases {
        la0 = &la;
    };
    leds {
      la: la {
        status = "okay";
        gpios = <&gpio1 7 GPIO_ACTIVE_HIGH>;
        label = "Output used for Logic Analyzer";
      };
    };
};
```

## src/main.c
```c
/* main.c - Application main entry point */
#include <sys/printk.h>

#include <settings/settings.h>
#include <devicetree.h>
#include <device.h>
#include <drivers/gpio.h>
#include <drivers/hwinfo.h>
#include <sys/byteorder.h>

#include <bluetooth/bluetooth.h>
#include <bluetooth/mesh.h>

#include "board.h"

/*---------------------------------------------------------------------------*/
//GPIO tracing
/* The devicetree node identifier for the "la0" alias. */
#define LA0_NODE DT_ALIAS(la0)

#define LA0    DT_GPIO_LABEL(LA0_NODE, gpios)
#define PIN    DT_GPIO_PIN(LA0_NODE, gpios)
#define FLAGS    DT_GPIO_FLAGS(LA0_NODE, gpios)

struct device *la_dev;
static uint16_t gpio_tracker = 0;

//counter to wait the first 1 minutes
static uint16_t countdown = 60;
//counter for amount of sends
static uint16_t countup = 60;
//id for the node, for recognition
static uint8_t node_id = -1;
/*---------------------------------------------------------------------------*/
//Mesh Node
#define OP_ONOFF_GET       BT_MESH_MODEL_OP_2(0x82, 0x01)
#define OP_ONOFF_SET       BT_MESH_MODEL_OP_2(0x82, 0x02)
#define OP_ONOFF_SET_UNACK BT_MESH_MODEL_OP_2(0x82, 0x03)
#define OP_ONOFF_STATUS    BT_MESH_MODEL_OP_2(0x82, 0x04)

static uint8_t sender = 0;

static void attention_on(struct bt_mesh_model *mod)
{
	printk("ON!\n");
	board_led_set(true);
}

static void attention_off(struct bt_mesh_model *mod)
{
	printk("OFF!\n");
	board_led_set(false);
}

static const struct bt_mesh_health_srv_cb health_cb = {
	.attn_on = attention_on,
	.attn_off = attention_off,
};

static struct bt_mesh_health_srv health_srv = {
	.cb = &health_cb,
};

BT_MESH_HEALTH_PUB_DEFINE(health_pub, 0);

static const char *const onoff_str[] = { "off", "on" };

static struct {
	bool val;
	uint16_t tid;
	uint16_t src;
	uint32_t transition_time;
	struct k_work_delayable work;
} onoff;

/* OnOff messages' transition time and remaining time fields are encoded as an
 * 8 bit value with a 6 bit step field and a 2 bit resolution field.
 * The resolution field maps to:
 * 0: 100 ms
 * 1: 1 s
 * 2: 10 s
 * 3: 20 min
 */
static const uint32_t time_res[] = {
	100,
	MSEC_PER_SEC,
	10 * MSEC_PER_SEC,
	10 * 60 * MSEC_PER_SEC,
};

static inline int32_t model_time_decode(uint8_t val)
{
	uint8_t resolution = (val >> 6) & BIT_MASK(2);
	uint8_t steps = val & BIT_MASK(6);

	if (steps == 0x3f) {
		return SYS_FOREVER_MS;
	}

	return steps * time_res[resolution];
}

static inline uint8_t model_time_encode(int32_t ms)
{
	if (ms == SYS_FOREVER_MS) {
		return 0x3f;
	}

	for (int i = 0; i < ARRAY_SIZE(time_res); i++) {
		if (ms >= BIT_MASK(6) * time_res[i]) {
			continue;
		}

		uint8_t steps = ceiling_fraction(ms, time_res[i]);

		return steps | (i << 6);
	}

	return 0x3f;
}

static int onoff_status_send(struct bt_mesh_model *model,
			     struct bt_mesh_msg_ctx *ctx)
{
	uint32_t remaining;

	BT_MESH_MODEL_BUF_DEFINE(buf, OP_ONOFF_STATUS, 3);
	bt_mesh_model_msg_init(&buf, OP_ONOFF_STATUS);

	remaining = k_ticks_to_ms_floor32(
			    k_work_delayable_remaining_get(&onoff.work)) +
		    onoff.transition_time;

	/* Check using remaining time instead of "work pending" to make the
	 * onoff status send the right value on instant transitions. As the
	 * work item is executed in a lower priority than the mesh message
	 * handler, the work will be pending even on instant transitions.
	 */
	if (remaining) {
		net_buf_simple_add_u8(&buf, !onoff.val);
		net_buf_simple_add_u8(&buf, onoff.val);
		net_buf_simple_add_u8(&buf, model_time_encode(remaining));
	} else {
		net_buf_simple_add_u8(&buf, onoff.val);
	}

	return bt_mesh_model_send(model, ctx, &buf, NULL, NULL);
}

static void onoff_timeout(struct k_work *work)
{
	if (onoff.transition_time) {
		/* Start transition.
		 *
		 * The LED should be on as long as the transition is in
		 * progress, regardless of the target value, according to the
		 * Bluetooth Mesh Model specification, section 3.1.1.
		 */
		board_led_set(true);

		k_work_reschedule(&onoff.work, K_MSEC(onoff.transition_time));
		onoff.transition_time = 0;
		return;
	}

	board_led_set(onoff.val);
}

/* Generic OnOff Server message handlers */

static int gen_onoff_get(struct bt_mesh_model *model,
			 struct bt_mesh_msg_ctx *ctx,
			 struct net_buf_simple *buf)
{
	onoff_status_send(model, ctx);
	return 0;
}

static int gen_onoff_set_unack(struct bt_mesh_model *model,
			       struct bt_mesh_msg_ctx *ctx,
			       struct net_buf_simple *buf)
{
	uint8_t val = net_buf_simple_pull_u8(buf);
	uint16_t tid = net_buf_simple_pull_le16(buf);
	uint8_t sid = net_buf_simple_pull_u8(buf);
	//pulling off extra payload
	//net_buf_simple_pull_le64(buf);
	
	int32_t trans = 0;
	int32_t delay = 0;

	/* Only perform change if the message wasn't a duplicate and the
	 * value is different.
	 */
	if (tid == onoff.tid && ctx->addr == onoff.src) {
		/* Duplicate */
		return 0;
	}

	if (val == onoff.val) {
		/* No change */
		return 0;
	}
	
	if(!sender){
		//trigger gpio pin
		gpio_pin_toggle(la_dev, PIN);
		//print sequence number, with gpio event, to map gpio to seq num (for pakage loss)
		printk("seq:%d gpio:%d sender:%d\n", tid, gpio_tracker, sid);
		//increment gpio tracker
		gpio_tracker++;
	}
	

	onoff.tid = tid;
	onoff.src = ctx->addr;
	onoff.val = val;
	onoff.transition_time = trans;

	/* Schedule the next action to happen on the delay, and keep
	 * transition time stored, so it can be applied in the timeout.
	 */
	k_work_reschedule(&onoff.work, K_MSEC(delay));

	return 0;
}

static int gen_onoff_set(struct bt_mesh_model *model,
			 struct bt_mesh_msg_ctx *ctx,
			 struct net_buf_simple *buf)
{
	(void)gen_onoff_set_unack(model, ctx, buf);
	onoff_status_send(model, ctx);

	return 0;
}



static const struct bt_mesh_model_op gen_onoff_srv_op[] = {
	{ OP_ONOFF_GET,       BT_MESH_LEN_EXACT(0), gen_onoff_get },
	{ OP_ONOFF_SET,       BT_MESH_LEN_MIN(2),   gen_onoff_set },
	{ OP_ONOFF_SET_UNACK, BT_MESH_LEN_MIN(2),   gen_onoff_set_unack },
	BT_MESH_MODEL_OP_END,
};

/* Generic OnOff Client */

static int gen_onoff_status(struct bt_mesh_model *model,
			    struct bt_mesh_msg_ctx *ctx,
			    struct net_buf_simple *buf)
{
	uint8_t present = net_buf_simple_pull_u8(buf);

	if (buf->len) {
		uint8_t target = net_buf_simple_pull_u8(buf);
		int32_t remaining_time =
			model_time_decode(net_buf_simple_pull_u8(buf));

		printk("OnOff status: %s -> %s: (%d ms)\n", onoff_str[present],
		       onoff_str[target], remaining_time);
		return 0;
	}

	printk("OnOff status: %s\n", onoff_str[present]);

	return 0;
}

static const struct bt_mesh_model_op gen_onoff_cli_op[] = {
	{OP_ONOFF_STATUS, BT_MESH_LEN_MIN(1), gen_onoff_status},
	BT_MESH_MODEL_OP_END,
};

/* This application only needs one element to contain its models */
static struct bt_mesh_model models[] = {
	BT_MESH_MODEL_CFG_SRV,
	BT_MESH_MODEL_HEALTH_SRV(&health_srv, &health_pub),
	BT_MESH_MODEL(BT_MESH_MODEL_ID_GEN_ONOFF_SRV, gen_onoff_srv_op, NULL,
		      NULL),
	BT_MESH_MODEL(BT_MESH_MODEL_ID_GEN_ONOFF_CLI, gen_onoff_cli_op, NULL,
		      NULL),
};

static struct bt_mesh_elem elements[] = {
	BT_MESH_ELEM(0, models, BT_MESH_MODEL_NONE),
};

static const struct bt_mesh_comp comp = {
	.cid = BT_COMP_ID_LF,
	.elem = elements,
	.elem_count = ARRAY_SIZE(elements),
};

/* Provisioning */

static int output_number(bt_mesh_output_action_t action, uint32_t number)
{
	printk("OOB Number: %u\n", number);

	board_output_number(action, number);

	return 0;
}

static void prov_complete(uint16_t net_idx, uint16_t addr)
{
	board_prov_complete();
}

static void prov_reset(void)
{
	bt_mesh_prov_enable(BT_MESH_PROV_ADV | BT_MESH_PROV_GATT);
}

static uint8_t dev_uuid[16];

static const struct bt_mesh_prov prov = {
	.uuid = dev_uuid,
	.output_size = 4,
	.output_actions = BT_MESH_DISPLAY_NUMBER,
	.output_number = output_number,
	.complete = prov_complete,
	.reset = prov_reset,
};

/** Send an OnOff Set message from the Generic OnOff Client to all nodes. */
static int gen_onoff_send(bool val)
{
	struct bt_mesh_msg_ctx ctx = {
		.app_idx = models[3].keys[0], /* Use the bound key */
		.addr = BT_MESH_ADDR_ALL_NODES,
		.send_ttl = BT_MESH_TTL_DEFAULT,
	};
	static uint16_t tid;

	if (ctx.app_idx == BT_MESH_KEY_UNUSED) {
		printk("The Generic OnOff Client must be bound to a key before "
		       "sending.\n");
		return -ENOENT;
	}

	int payload_size = (8+16+8)/8;
	//uint64_t extra_payload = 0;

	BT_MESH_MODEL_BUF_DEFINE(buf, OP_ONOFF_SET_UNACK, payload_size);
	bt_mesh_model_msg_init(&buf, OP_ONOFF_SET_UNACK);
	net_buf_simple_add_u8(&buf, val);
	net_buf_simple_add_le16(&buf, tid++);
	net_buf_simple_add_u8(&buf, node_id);
	//net_buf_simple_add_le64(&buf, extra_payload);
	//net_buf_simple_add_le64(&buf, extra_payload);
	//net_buf_simple_add_le64(&buf, extra_payload);
	//net_buf_simple_add_le16(&buf, (uint16_t)extra_payload);

	return bt_mesh_model_send(&models[3], &ctx, &buf, NULL, NULL);
}

static void send(struct k_timer *timer)
{
	//skip the first 60 sends (60 seconds)
	if(countdown == 0){
		if(countup == 0){
			return;
		}

		countup--;
		if (bt_mesh_is_provisioned()) {

			//trigger gpio pin
			gpio_pin_toggle(la_dev, PIN);
			//increment gpio tracker

			printk("Sent packet with gpio:%d\n", gpio_tracker);

			gpio_tracker++;

			(void)gen_onoff_send(!onoff.val);
			return;
		}

	}else{
		countdown--;
	}
}

static void bt_ready(int err)
{
	if (err) {
		printk("Bluetooth init failed (err %d)\n", err);
		return;
	}

	printk("Bluetooth initialized\n");

	err = bt_mesh_init(&prov, &comp);
	if (err) {
		printk("Initializing mesh failed (err %d)\n", err);
		return;
	}

	if (IS_ENABLED(CONFIG_SETTINGS)) {
		settings_load();
	}

	/* This will be a no-op if settings_load() loaded provisioning info */
	bt_mesh_prov_enable(BT_MESH_PROV_ADV | BT_MESH_PROV_GATT);

	printk("Mesh initialized\n");
}

static void self_provision(){
	/* Self-provision with an arbitrary address.
	 *
	 * NOTE: This should never be done in a production environment.
	 *       Addresses should be assigned by a provisioner, and keys should
	 *       be generated from true random numbers. It is done in this
	 *       sample to allow testing without a provisioner.
	 */
	static uint8_t net_key[16];
	static uint8_t dev_key[16];
	static uint8_t app_key[16];
	uint16_t addr;
	int err;

	if (IS_ENABLED(CONFIG_HWINFO)) {
		addr = sys_get_le16(&dev_uuid[0]) & BIT_MASK(15);
	} else {
		addr = k_uptime_get_32() & BIT_MASK(15);
	}

	printk("Self-provisioning with address 0x%04x\n", addr);
	err = bt_mesh_provision(net_key, 0, 0, 0, addr, dev_key);
	if (err) {
		printk("Provisioning failed (err: %d)\n", err);
		return;
	}

	/* Add an application key to both Generic OnOff models: */
	err = bt_mesh_app_key_add(0, 0, app_key);
	if (err) {
		printk("App key add failed (err: %d)\n", err);
		return;
	}

	/* Models must be bound to an app key to send and receive messages with
	 * it:
	 */
	models[2].keys[0] = 0;
	models[3].keys[0] = 0;

	printk("Provisioned and configured!\n");
}


//2 {0x40, 0xb6, 0x7b, 0x4e, 0x92, 0x1a, 0x44, 0x34, 0x00, 0x00, 0x00, 0x00, 0x00, 0x00, 0x00, 0x00}
//5 {0x95, 0xdf, 0xd0, 0x28, 0x02, 0x7e, 0x5a, 0x59, 0x00, 0x00, 0x00, 0x00, 0x00, 0x00, 0x00, 0x00}
//8 {0x8b, 0xfc, 0x6c, 0x15, 0x39, 0xf7, 0xb9, 0xe3, 0x00, 0x00, 0x00, 0x00, 0x00, 0x00, 0x00, 0x00}
//19 {0xf8, 0x37, 0x45, 0x92, 0x01, 0xa3, 0x68, 0x86, 0x00, 0x00, 0x00, 0x00, 0x00, 0x00, 0x00, 0x00}

static uint8_t cmp_uuid[16] = {0x95, 0xdf, 0xd0, 0x28, 0x02, 0x7e, 0x5a, 0x59, 0x00, 0x00, 0x00, 0x00, 0x00, 0x00, 0x00, 0x00}; //ID: 5

static uint8_t cmp_uuid2[16] = {0x40, 0xb6, 0x7b, 0x4e, 0x92, 0x1a, 0x44, 0x34, 0x00, 0x00, 0x00, 0x00, 0x00, 0x00, 0x00, 0x00}; //ID: 2
static uint8_t cmp_uuid8[16] = {0x8b, 0xfc, 0x6c, 0x15, 0x39, 0xf7, 0xb9, 0xe3, 0x00, 0x00, 0x00, 0x00, 0x00, 0x00, 0x00, 0x00}; //ID: 8
static uint8_t cmp_uuid19[16] = {0xf8, 0x37, 0x45, 0x92, 0x01, 0xa3, 0x68, 0x86, 0x00, 0x00, 0x00, 0x00, 0x00, 0x00, 0x00, 0x00}; //ID: 19

bool uuid_in_list(uint8_t uuid1[16], uint8_t uuid2[16])
{
	int i;
		
	// check every part of uuid, if one is false, exit
	for (i = 0; i < 16; i++)
	{
		if (uuid1[i] != uuid2[i])
		{
			return false;
		}
	}
	return true;
}

void main(void)
{
	printk("Initializing...\n");
	int err;
	
	//get hardware info
	if (IS_ENABLED(CONFIG_HWINFO)) {
		err = hwinfo_get_device_id(dev_uuid, sizeof(dev_uuid));
	}
	//check for error
	if (err < 0) {
		dev_uuid[0] = 0xdd;
		dev_uuid[1] = 0xdd;
	}

	//Display UUID of device
	printk("The UUID of the device is: ");
	int i;
	for(i = 0; i<16; i++){
		printk("0x%02x ", dev_uuid[i]);
	}
	printk("\n");

	//Start the onoff work service
	k_work_init_delayable(&onoff.work, onoff_timeout);

	/* Initialize the Bluetooth Subsystem */
	err = bt_enable(bt_ready);
	if (err) {
		printk("Bluetooth init failed (err %d)\n", err);
		return;
	}

	la_dev = device_get_binding(LA0);
	if (la_dev == NULL) {
		printk("GPIO init failed!\n");
		return;
	}else{
		printk("GPIO init successful!\n");
	}

	err = gpio_pin_configure(la_dev, PIN, GPIO_OUTPUT);
	if (err < 0) {
		printk("GPIO configure failed (err %d)!\n", err);
		return;
	}else{
		printk("GPIO configure successful!\n");
	}

	//Start self-provisioning
	self_provision();

	//check if sender uuid is the selected one
	bool helper = false;

	if(uuid_in_list(dev_uuid, cmp_uuid)){
		node_id = 5;
		helper = true;
	}
	/*else if(uuid_in_list(dev_uuid, cmp_uuid2)){
		node_id = 2;
		helper = false;
	}
	else if(uuid_in_list(dev_uuid, cmp_uuid8)){
		node_id = 8;
		helper = false;
	}
	else if(uuid_in_list(dev_uuid, cmp_uuid19)){
		node_id = 19;
		helper = false;
	}*/

	if(helper){
		printk("I am the sender node!\n");
		sender = 1;
		static struct k_timer my_timer;

		//Initiate Timer
		k_timer_init(&my_timer, send, NULL);
		
		//timer expires once per second
		k_timer_start(&my_timer, K_SECONDS(1), K_SECONDS(1));
	}
		
}
```
